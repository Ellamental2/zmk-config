## config/west.yml
```yaml
manifest:
  remotes:
    - name: zmkfirmware
      url-base: https://github.com/zmkfirmware
    - name: zmklocales
      url-base: https://github.com/joelspadin/zmk-locales
  projects:
    - name: zmk
      remote: zmkfirmware
      revision: main
      import: app/west.yml
    - name: locales
      remote: zmklocales
      revision: main
      import: app/west.yml
  self:
    path: config
```
